## conf/machine/dragonflyte.conf
```bitbake
#@TYPE: Machine
#@NAME: Dragonflyte
#@SOC: i.MX6SX
#@DESCRIPTION: Machine configuration for Dragonflyte
#@MAINTAINER: Raphael Chang <raphaelchang1227@gmail.com>

MACHINEOVERRIDES =. "mx6:mx6sx:"

require conf/machine/include/imx6sabresd-common.inc

PREFERRED_PROVIDER_virtual/kernel ?= "linux-imx"

KERNEL_DEVICETREE = "imx6sx-sdb.dtb imx6sx-sdb-emmc.dtb imx6sx-sdb-m4.dtb \
                     imx6sx-sdb-sai.dtb imx6sx-sdb-lcdif1.dtb imx6sx-sdb-ldo.dtb \
                     imx6sx-sdb-reva-ldo.dtb imx6sx-sdb-reva.dtb \
                     imx6sx-sdb-btwifi.dtb imx6sx-sdb-mqs.dtb"

UBOOT_CONFIG[sd] = "mx6sxsabresd_config,sdcard"
UBOOT_CONFIG[emmc] = "mx6sxsabresd_emmc_config,sdcard"
UBOOT_CONFIG[qspi2] = "mx6sxsabresd_qspi2_config"
UBOOT_CONFIG[m4fastup] = "mx6sxsabresd_m4fastup_config"
UBOOT_CONFIG[mfgtool] = "mx6sxsabresd_config"
```
